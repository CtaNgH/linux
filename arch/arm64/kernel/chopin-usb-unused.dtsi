// SPDX-License-Identifier: GPL-2.0-only
/*
 * chopin: the USB controllers this board does not use.
 */

&{/usb3@11200000}     { status = "disabled"; };
&{/usb_xhci@11200000} { status = "disabled"; };
&{/usb0phy@11e40000}  { status = "disabled"; };

/* ---- watchdog ----
 *
 * The base tree has the toprgu at 0x10007000 but with compatible
 * "mediatek,toprgu", which matches nothing in mainline - so the watchdog the
 * bootloader arms was never taken over by anything, and the board reset itself
 * on its own.  Mainline's mtk_wdt drives the same registers for every SoC it
 * supports; the per-SoC data only says how many software resets the toprgu
 * exposes, and nothing here consumes those, so the oldest data-less binding is
 * the safe choice (it registers no reset controller at all).
 *
 * With the driver bound, mtk_wdt_init() notices the bootloader-enabled watchdog
 * (WDT_MODE_EN) and marks WDOG_HW_RUNNING; CONFIG_WATCHDOG_HANDLE_BOOT_ENABLED
 * then has the watchdog core pet it without any userspace, which is the whole
 * point - there is no watchdog daemon in this initramfs.
 *
 * "interrupts" is left alone (the bank's pretimeout IRQ, from the vendor tree)
 * and "mediatek,disable-extrst" is deliberately NOT set: I have not established
 * what clearing WDT_MODE_EXRST_EN does on this SoC, and feeding the watchdog is
 * what should stop the resets, not changing its reset semantics.
 */
