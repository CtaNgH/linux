// SPDX-License-Identifier: GPL-2.0-only
/*
 * chopin: the framebuffer reservation and chosen.
 */

&{/reserved-memory/mblock-19-framebuffer} {
	no-map;
};

&{/chosen} {
	#address-cells = <2>;
	#size-cells = <2>;
	ranges;

	framebuffer@78e0c000 {
		compatible = "simple-framebuffer";
		reg = <0 0x78e0c000 0 0x9f6000>;
		width = <1080>;
		height = <2400>;
		stride = <((1080 + 8) * 4)>;
		format = "a8r8g8b8";
		status = "okay";
	};
};

/* ====================== DRM / display bring-up ====================== */
/*
 * Everything from here down turns the bootloader's display setup into a
 * mainline DRM pipeline.
 *
 * The base tree is LK's *vendor* device tree: the display blocks are all there
 * with the right register bases, interrupts and (vendor) clock specifiers, but
 * their compatible strings match no mainline driver and their clocks reference
 * the vendor clock ID space.  So each block gets restated in mainline terms,
 * exactly like the UFS/I2C/SPI blocks above.
 *
 * Component compatible strings.  MT6893's display hardware is the MT6885
 * generation, which is *not* register compatible with mt8183/mt8192 MMSYS
 * routing (hence the dedicated mmsys driver data), but the DDP blocks
 * themselves are close enough to the mt8173/mt8183/mt8192 blocks that the
 * existing component drivers fit:
 *
 *   disp_ovl0        mt8192-disp-ovl         (two SMI/IOMMU ids, like this SoC)
 *   disp_ovl0_2l     mt8192-disp-ovl-2l
 *   disp_rdma0       mt8183-disp-rdma
 *   disp_color0      mt8173-disp-color
 *   disp_ccorr0      mt8192-disp-ccorr
 *   disp_aal0        mt8183-disp-aal
 *   disp_gamma0      mt8183-disp-gamma
 *   disp_postmask0   mt8192-disp-postmask
 *   disp_dither0     mt8183-disp-dither
 *   dsi0             mt6893-dsi            (mt8183 register layout, no shadow)
 *   disp_mutex0      mt6893-disp-mutex     (mt6885 module bits)
 *
 * Note that only OVL0 is put into the DRM path (see mmsys_mt6893_routing_table
 * for why OVL0 -> RDMA0 does not need OVL0_2L as a background source).
 *
 * The vendor "iommus" properties are deliberately left in place: they point at
 * the vendor IOMMU nodes, which no mainline driver claims, so the DMA API
 * falls back to physical addresses.  LK itself runs this display with the MMU
 * (m4u) off, and its routing is what we inherit.
 */
