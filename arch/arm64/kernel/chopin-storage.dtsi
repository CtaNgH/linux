// SPDX-License-Identifier: GPL-2.0-only
/*
 * chopin: UFS host, its phy and infracfg.
 */

&{/ufshci@11270000} {
	compatible = "mediatek,mt6893-ufshci", "mediatek,mt8183-ufshci";
	vcc-supply = <&ufs_fixed_vcc>;
	clocks = <&{/infracfg_ao@10001000} CLK_INFRA_AO_UFS>,
		 <&{/topckgen@10000000} CLK_TOP_UFS_SEL>;
	clock-names = "ufs", "ufs_sel";
	freq-table-hz = <0 0>, <0 0>;
	phys = <&{/ufs_mphy@11fa0000}>;

	/*
	 * The controller resets.  Without these ufs-mediatek.c reports
	 *
	 *   Failed to get reset control hci_rst: -2      (and unipro/crypto/mphy)
	 *
	 * because devm_reset_control_get() is not the _optional() flavour, and
	 * the host then relies on whatever state the bootloader left behind.
	 * The order below matches reset-names, which is what the driver looks up
	 * by name, so the pairing is: hci->UFSHCI, unipro->UNIPRO,
	 * crypto->UFSCPT (the vendor driver comments this one "reset AES"),
	 * mphy->UFSPHY (the vendor calls its target bit SW_RST_TARGET_MPHY).
	 */
	resets = <&{/infracfg_ao@10001000} MT6893_INFRA_RST1_UFSHCI_SW_RST>,
		 <&{/infracfg_ao@10001000} MT6893_INFRA_RST2_UNIPRO_SW_RST>,
		 <&{/infracfg_ao@10001000} MT6893_INFRA_RST3_UFSCPT_SW_RST>,
		 <&{/infracfg_ao@10001000} MT6893_INFRA_RST2_UFSPHY_SW_RST>;
	reset-names = "hci_rst", "unipro_rst", "crypto_rst", "mphy_rst";

	mediatek,ufs-disable-mcq;
	mediatek,ufs-broken-vcc;
};

/*
 * The infracfg_ao node is our reset provider: clk-mt6893-infra_ao.c registers
 * the four UFS resets above through mtk_register_reset_controller_with_dev(),
 * which takes #reset-cells from this very node.  The vendor tree never needed
 * the property because its UFS driver pokes the INFRA_RST set/clear registers
 * through a syscon instead of going through the reset framework.
 */
&{/infracfg_ao@10001000} {
	#reset-cells = <1>;
};

&{/ufs_mphy@11fa0000} {
	compatible = "mediatek,mt6893-ufsphy", "mediatek,mt8183-ufsphy";
	#phy-cells = <0>;
	clocks = <&{/infracfg_ao@10001000} CLK_INFRA_AO_UNIPRO_SYSCLK>,
		 <&{/infracfg_ao@10001000} CLK_INFRA_AO_UFS_MP_SAP_BCLK>;
	clock-names = "unipro", "mp";
};

/* ---- SPI: restate the vendor clock references in mainline terms ----
 *
 * All eight SPI controllers are enabled in the base tree and all eight failed
 * to probe, in two different ways:
 *
 *   spi0..spi3   "failed to clk_set_parent" (-EINVAL)
 *   spi4..spi7   "failed to get spi-clk"    (-ENOENT)
 *
 * One root cause: the base tree is a flattened *vendor* tree, so its clock
 * references are vendor (MT6885 ID space) indices, while our mainline clock
 * drivers number things differently.  Decoded against the vendor kernel's
 * include/dt-bindings/clock/mt6885-clk.h (kept as work/vendor-clk/), every SPI
 * node says exactly:
 *
 *   clocks = <&topckgen   TOP_MAINPLL_D5_D4>  vendor id 0x53 = 83  parent-clk
 *            <&topckgen   TOP_MUX_SPI>        vendor id 0x1c = 28  sel-clk
 *            <&infracfg_ao INFRACFG_AO_SPIn_CG> 0x1e/0x3b/...      spi-clk
 *
 * Those indices land elsewhere in our ID space.  Mainline CLK_TOP_SPI_SEL is
 * 111, so vendor index 28 is some other topckgen clock - not a mux, hence
 * clk_set_parent()'s -EINVAL.  And the vendor SPI gate indices (30, 59, 61, 62,
 * 77, 78, 108, 109) hit either gaps in our clk table or run past its end (88
 * gates), hence the -ENOENT.
 *
 * So each node restates its three clocks with mainline ids.  All eight share
 * parent and mux; only the gate differs:
 *
 *   parent-clk  CLK_TOP_MAINPLL_D5_D4   the vendor's own choice, and one of the
 *                                       four parents CLK_TOP_SPI_SEL accepts
 *                                       (spi_parents[] = clk26m, mainpll_d5_d4,
 *                                       mainpll_d6_d4, msdcpll_d4)
 *   sel-clk     CLK_TOP_SPI_SEL         the mux the driver clk_set_parent()s
 *   spi-clk     CLK_INFRA_AO_SPI0..7    the gate; upstream spells the last two
 *                                       CLK_INFRA_AO_SPI6_CK / _SPI7_CK
 *
 * Note: the only device on any of these buses is an ST54 NFC controller on
 * spi5, and mainline has no driver for "st,st54spi" - so this makes the
 * controllers usable, not the NFC chip.
 */
/*
 * I2C6 is where both sub-PMICs live: the MT6360 (charger/Type-C/ADC, PMU at
 * 0x34) and the MT6691 that feeds the UFS rail (0x51).  Like the SPI nodes
 * below, the base tree carries vendor bindings that no mainline driver matches:
 * compatible "mediatek,i2c" (i2c-mt65xx wants a SoC-specific string) and clock
 * phandles in the vendor's own numbering.  Rewrite both.  clock-div stays the
 * vendor's 5 - that describes the hardware, not the binding, and it is what LK
 * used when it talked to these chips successfully.
 */
