// SPDX-License-Identifier: GPL-2.0-only
/*
 * chopin: the USB controller that is used.
 */

/*
 * NOTE: this fragment is documentation only - the runtime board tree is
 * arch/arm64/boot/dts/mediatek/mt6893.dtsi, which already carries these
 * overrides.  Keep it in sync by hand.
 *
 * chopin: peripheral-only.  dr_mode = "otg" makes the mtu3 driver require
 * the otg_vbus regulator (registered by the MT6360 charger on i2c5); when
 * that probe fails the controller defers forever and the phone enumerates
 * no USB device at all.  See the long comment in mt6893.dtsi.
 */
&{/usb@11201000} {
	dr_mode = "peripheral";
	/delete-property/ usb-role-switch;
	/delete-property/ role-switch-default-mode;
	/delete-property/ vbus-supply;
};

/* ---- On-screen console on the framebuffer LK leaves scanning out ---- */
/*
 * LK leaves the display controller scanning out its own buffer and nothing in
 * this kernel reprograms the pipeline yet, so the whole job here is to make
 * that buffer reachable from Linux and let fbcon draw into it.
 *
 * The live buffer is 0x78e0c000 - LK's last "mt_disp_config_fb_layer, addr ="
 * - and it sits inside the vendor reserved region mblock-19-framebuffer
 * (0x77a20000..0x7a1fffff).  In the base tree that region is NOT no-map, so it
 * stays part of the kernel's linear map and arm64 refuses to ioremap it
 * (arch/arm64/mm/ioremap.c):
 *
 *   WARN_ONCE(pfn_is_map_memory(...), "ioremap attempted on RAM pfn") -> NULL
 *
 * which simplefb reported as
 *
 *   simplefb: cannot reserve video memory at [mem 0x78e0c000-0x7b5ebfff]
 *   probe with driver simple-framebuffer failed with error -12
 *
 * (request_mem_region() failing is only a warning; the NULL ioremap_wc() is
 * the fatal part.)  Marking the region no-map takes it out of the linear map,
 * after which both request_mem_region() and ioremap_wc() succeed.  The working
 * MT6895 port on this SoC does exactly this for its mblock-12-framebuffer.
 *
 * Two consequences, both handled:
 *  - reg below must stay inside the region, or ioremap() would alias System
 *    RAM again: 0x78e0c000 + 0x9f6000 = 0x79803000 < 0x7a200000.  One frame
 *    is stride(4352) * height(2400) = 0x9f6000;
 *  - nothing may reach that memory through __va() any more.  head.S is
 *    unaffected (it paints its K00..K03 stripes with the MMU still off, i.e.
 *    with plain physical stores), but the driver's post-paging_init painter
 *    had to move from __va() to ioremap_wc(): see fb_band_late() in
 *    drivers/misc/mtk-logstore-console.c.
 */
